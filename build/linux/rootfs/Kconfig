## build/linux/rootfs/Kconfig
```kconfig
mainmenu "linux/rootfs Configuration"
config ARCH_ARM
	bool
	default y
menu "Filesystem Packages"
source /home/jie/opt/pkg/petalinux-v2015.4-final/components/packages-repo/Kconfig.defaults
if ROOTFS_ADVANCED_MODE
choice
	prompt "packages-repo"
config ROOTFS_COMPONENT_PACKAGES__REPO_NAME_PLNX__REPO
	bool "plnx-repo"
endchoice
if ROOTFS_COMPONENT_PACKAGES__REPO_NAME_PLNX__REPO
source /home/jie/opt/pkg/petalinux-v2015.4-final/components//packages-repo/plnx-repo/Kconfig
endif
endif
if !ROOTFS_ADVANCED_MODE
config ROOTFS_COMPONENT_PACKAGES__REPO_NAME_PLNX__REPO
	bool
	default y
source /home/jie/opt/pkg/petalinux-v2015.4-final/components/packages-repo/plnx-repo/Kconfig
endif
endmenu
menu "Libs"
endmenu
menu "Apps"
menuconfig ROOTFS_COMPONENT_APPS_NAME_ECHO_TEST
	bool "echo_test"
source /home/jie/opt/pkg/Xilinx-ZC702-2015.4/components//apps/echo_test/Kconfig
menuconfig ROOTFS_COMPONENT_APPS_NAME_FWUPGRADE
	bool "fwupgrade"
source /home/jie/opt/pkg/petalinux-v2015.4-final/components//apps/fwupgrade/Kconfig
menuconfig ROOTFS_COMPONENT_APPS_NAME_GPIO__DEMO
	bool "gpio-demo"
source /home/jie/opt/pkg/petalinux-v2015.4-final/components//apps/gpio-demo/Kconfig
menuconfig ROOTFS_COMPONENT_APPS_NAME_LATENCYSTAT
	bool "latencystat"
source /home/jie/opt/pkg/petalinux-v2015.4-final/components//apps/latencystat/Kconfig
menuconfig ROOTFS_COMPONENT_APPS_NAME_LINUX_LED_TEST
	bool "linux_led_test"
source /home/jie/opt/pkg/Xilinx-ZC702-2015.4/components//apps/linux_led_test/Kconfig
menuconfig ROOTFS_COMPONENT_APPS_NAME_MAT_MUL_DEMO
	bool "mat_mul_demo"
source /home/jie/opt/pkg/Xilinx-ZC702-2015.4/components//apps/mat_mul_demo/Kconfig
menuconfig ROOTFS_COMPONENT_APPS_NAME_PEEKPOKE
	bool "peekpoke"
source /home/jie/opt/pkg/petalinux-v2015.4-final/components//apps/peekpoke/Kconfig
menuconfig ROOTFS_COMPONENT_APPS_NAME_PROXY_APP
	bool "proxy_app"
source /home/jie/opt/pkg/Xilinx-ZC702-2015.4/components//apps/proxy_app/Kconfig
menuconfig ROOTFS_COMPONENT_APPS_NAME_VIVO_LINUX_RECEIVE
	bool "vivo_linux_receive"
source /home/jie/opt/pkg/Xilinx-ZC702-2015.4/components//apps/vivo_linux_receive/Kconfig
endmenu
menu "Modules"
menuconfig ROOTFS_COMPONENT_MODULES_NAME_RPMSG_ECHO_TEST_KERN_APP
	bool "rpmsg_echo_test_kern_app"
menuconfig ROOTFS_COMPONENT_MODULES_NAME_RPMSG_MAT_MUL_KERN_APP
	bool "rpmsg_mat_mul_kern_app"
menuconfig ROOTFS_COMPONENT_MODULES_NAME_RPMSG_PROXY_DEV_DRIVER
	bool "rpmsg_proxy_dev_driver"
menuconfig ROOTFS_COMPONENT_MODULES_NAME_RPMSG_USER_DEV_DRIVER
	bool "rpmsg_user_dev_driver"
endmenu
menu "PetaLinux RootFS Settings"
config ROOTFS_ROOT_PASSWD
	string "Root password"
	default ""
	help
	  Default login password for the 'root' user, on your PetaLinux system.

comment "Service configuration"
config ROOTFS_BUSYBOX_INETD_FTPD
	bool "Enable busybox FTPD with inetd service"
	select ROOTFS_PACKAGES_BUSYBOX_INETD
	default 'y'
	help
	 Select this option to enable busybox ftpd with inetd service and
	 run it on startup.

config ROOTFS_BUSYBOX_INETD_TELNETD
	bool "Enable busybox TELNETD with inetd service"
	select ROOTFS_PACKAGES_BUSYBOX_INETD
	default 'y'
	help
	 Select this option to enable busybox telnetd with inetd
	 service and run it on startup.
endmenu

#############################################################################

menu "Debugging"

config USER_DEBUG
	bool "build debugable applications"
	help
	 Build all user application with debug symbols and reduced optimisation
	 levels.  See also debug build option in force library building.  Withou
	 this option debug symbols are still included, however the optimisation
	 level is increased and this can lead to problematic debugging.

endmenu
```
